## zmk/app/boards/shields/p1/Kconfig.defconfig
```kconfig
# Copyright (c) 2021 The ZMK Contributors
# SPDX-License-Identifier: MIT

if SHIELD_P1

config ZMK_KEYBOARD_NAME
	default "Pabile 1-Key"

endif
```

## zmk/app/boards/shields/p40v2/Kconfig.defconfig
```kconfig
# Copyright (c) 2021 The ZMK Contributors
# SPDX-License-Identifier: MIT

if SHIELD_P40V2

config ZMK_KEYBOARD_NAME
	default "P40v2 ithock"

endif
```

## zmk/app/boards/shields/p40v2/Kconfig.shield
```kconfig
# Copyright (c) 2021 The ZMK Contributors
# SPDX-License-Identifier: MIT

config SHIELD_P40V2
	def_bool $(shields_list_contains,p40v2)
```

## zmk/app/boards/shields/p42lite/Kconfig.defconfig
```kconfig
# Copyright (c) 2021 The ZMK Contributors
# SPDX-License-Identifier: MIT

if SHIELD_P42LITE

config ZMK_KEYBOARD_NAME
	default "Pabile42"

endif
```

## zmk/app/boards/shields/p42lite/Kconfig.shield
```kconfig
# Copyright (c) 2021 The ZMK Contributors
# SPDX-License-Identifier: MIT

config SHIELD_P42LITE
	def_bool $(shields_list_contains,p42lite)
```

## zmk/app/boards/shields/p45/Kconfig.defconfig
```kconfig
# Copyright (c) 2021 The ZMK Contributors
# SPDX-License-Identifier: MIT

if SHIELD_P45

config ZMK_KEYBOARD_NAME
	default "Pabile 45-Key"

endif
```

## zmk/app/boards/shields/p45/Kconfig.shield
```kconfig
# Copyright (c) 2021 The ZMK Contributors
# SPDX-License-Identifier: MIT

config SHIELD_P45
	def_bool $(shields_list_contains,p45)
```

## zmk/app/boards/shields/pabile2/Kconfig.defconfig
```kconfig
# Copyright (c) 2021 The ZMK Contributors
# SPDX-License-Identifier: MIT

if SHIELD_PABILE2

config ZMK_KEYBOARD_NAME
	default "Pee-two"

endif
```

## zmk/app/boards/shields/pabile2/Kconfig.shield
```kconfig
# Copyright (c) 2021 The ZMK Contributors
# SPDX-License-Identifier: MIT

config SHIELD_PABILE2
	def_bool $(shields_list_contains,pabile2)
```

## zmk/app/boards/shields/pabile38/Kconfig.defconfig
```kconfig
# Copyright (c) 2023 The ZMK Contributors
# SPDX-License-Identifier: MIT

if SHIELD_PABILE38

config ZMK_KEYBOARD_NAME
    default "Pabile38"

endif
```

## zmk/app/boards/shields/pabile38/Kconfig.shield
```kconfig
# Copyright (c) 2023 The ZMK Contributors
# SPDX-License-Identifier: MIT

config SHIELD_PABILE38
    def_bool $(shields_list_contains,pabile38)
```

## zmk/app/boards/shields/pabile40v1/Kconfig.defconfig
```kconfig
# Copyright (c) 2025 The ZMK Contributors
# SPDX-License-Identifier: MIT

if SHIELD_PABILE40V1

config ZMK_KEYBOARD_NAME
	default "Pabile40V1"

endif
```

## zmk/app/boards/shields/pabile40v1/Kconfig.shield
```kconfig
# Copyright (c) 2025 The ZMK Contributors
# SPDX-License-Identifier: MIT

config SHIELD_PABILE40V1
	def_bool $(shields_list_contains,pabile40v1)
```

## zmk/app/boards/shields/pabile40v3/Kconfig.defconfig
```kconfig
# Copyright (c) 2023 The ZMK Contributors
# SPDX-License-Identifier: MIT

if SHIELD_PABILE40V3

config ZMK_KEYBOARD_NAME
	default "Pabile40V3"

endif
```

## zmk/app/boards/shields/pabile40v3/Kconfig.shield
```kconfig
# Copyright (c) 2023 The ZMK Contributors
# SPDX-License-Identifier: MIT

config SHIELD_PABILE40V3
	def_bool $(shields_list_contains,pabile40v3)
```

## zmk/app/boards/shields/pabile42/Kconfig.defconfig
```kconfig
# Copyright (c) 2021 The ZMK Contributors
# SPDX-License-Identifier: MIT

if SHIELD_PABILE42

config ZMK_KEYBOARD_NAME
	default "Pabile42"

endif
```

## zmk/app/boards/shields/pabile45/Kconfig.defconfig
```kconfig
# Copyright (c) 2023 The ZMK Contributors
# SPDX-License-Identifier: MIT

if SHIELD_PABILE45

config ZMK_KEYBOARD_NAME
	default "Pabile45"

endif
```

## zmk/app/boards/shields/pabile45/Kconfig.shield
```kconfig
# Copyright (c) 2023 The ZMK Contributors
# SPDX-License-Identifier: MIT

config SHIELD_PABILE45
	def_bool $(shields_list_contains,pabile45)
```

## zmk/app/boards/shields/pabile9/Kconfig.defconfig
```kconfig
# Copyright (c) 2025 The ZMK Contributors
# SPDX-License-Identifier: MIT

if SHIELD_PABILE9

config ZMK_KEYBOARD_NAME
	default "Pabile9"

endif
```

## zmk/app/boards/shields/pabile9/Kconfig.shield
```kconfig
# Copyright (c) 2025 The ZMK Contributors
# SPDX-License-Identifier: MIT

config SHIELD_PABILE9
	def_bool $(shields_list_contains,pabile9)
```
